## configs/zedboard_defconfig
```kconfig
BR2_arm=y
BR2_cortex_a9=y
BR2_ARM_FPU_VFPV3=y
BR2_TOOLCHAIN_EXTERNAL=y
BR2_TOOLCHAIN_EXTERNAL_CODESOURCERY_ARM201203=y
BR2_TARGET_GENERIC_HOSTNAME="devzed"
BR2_TARGET_GENERIC_ISSUE="Welcome to Zedboard!"
BR2_ROOTFS_DEVICE_CREATION_DYNAMIC_UDEV=y
BR2_TARGET_GENERIC_ROOT_PASSWD="rub"
BR2_TARGET_GENERIC_GETTY_PORT="ttyPS0"
BR2_ROOTFS_OVERLAY="$(TOPDIR)/overlay"
BR2_LINUX_KERNEL=y
BR2_LINUX_KERNEL_CUSTOM_GIT=y
BR2_LINUX_KERNEL_CUSTOM_REPO_URL="http://www.github.com/Xilinx/linux-xlnx.git"
BR2_LINUX_KERNEL_CUSTOM_REPO_VERSION="xilinx-v14.6.02"
BR2_LINUX_KERNEL_DEFCONFIG="xilinx_zynq"
BR2_LINUX_KERNEL_UIMAGE_LOADADDR="0x108000"
BR2_LINUX_KERNEL_DTS_SUPPORT=y
BR2_LINUX_KERNEL_USE_CUSTOM_DTS=y
BR2_LINUX_KERNEL_CUSTOM_DTS_PATH="$(TOPDIR)/board/zynq/zedboard/zedboard.dts"
BR2_PACKAGE_UIOCTL=y
BR2_PACKAGE_LIBFFI=y
BR2_PACKAGE_READLINE=y
BR2_PACKAGE_AVAHI=y
BR2_PACKAGE_AVAHI_DAEMON=y
BR2_PACKAGE_DROPBEAR=y
BR2_PACKAGE_SCREEN=y
BR2_PACKAGE_NANO=y
# BR2_PACKAGE_NANO_TINY is not set
BR2_TARGET_ROOTFS_EXT2=y
BR2_TARGET_ROOTFS_EXT2_UBOOT=y
BR2_TARGET_ROOTFS_EXT2_LOADADDR="0x2000000"
BR2_TARGET_ROOTFS_EXT2_GZIP=y
BR2_TARGET_UBOOT=y
BR2_TARGET_UBOOT_BOARDNAME="zynq_zed"
BR2_TARGET_UBOOT_CUSTOM_GIT=y
BR2_TARGET_UBOOT_CUSTOM_REPO_URL="https://github.com/vxmdesign/u-boot-xlnx.git"
BR2_TARGET_UBOOT_CUSTOM_REPO_VERSION="vxm-uboot-v1.1"
BR2_TARGET_UBOOT_FORMAT_ZYNQ=y
```

## package/python-tinyrpc/Config.in
```kconfig
config BR2_PACKAGE_PYTHON_TINYRPC
    bool "python-tinyrpc"
    depends on BR2_PACKAGE_PYTHON
    select BR2_PACKAGE_PYTHON_SETUPTOOLS
    select BR2_HOST_PACKAGE_PYTHON_SETUPTOOLS
    help
      https://tinyrpc.readthedocs.org/
```

## package/python-werkzeug/Config.in
```kconfig
config BR2_PACKAGE_PYTHON_WERKZEUG
    bool "python-werkzeug"
    depends on BR2_PACKAGE_PYTHON
    select BR2_PACKAGE_PYTHON_SETUPTOOLS
    select BR2_HOST_PACKAGE_PYTHON_SETUPTOOLS
    help
      http://werkzeug.pocoo.org/
```

## package/python-ws4py/Config.in
```kconfig
config BR2_PACKAGE_PYTHON_WS4PY
    bool "python-ws4py"
    depends on BR2_PACKAGE_PYTHON
    select BR2_PACKAGE_PYTHON_SETUPTOOLS
    select BR2_HOST_PACKAGE_PYTHON_SETUPTOOLS
    help
      https://ws4py.readthedocs.org
```

## package/uioctl/Config.in
```kconfig
config BR2_PACKAGE_UIOCTL
	bool "uioctl"
	help
	  Simple program to read/write from/to Userspace I/O Devices.

	  http://github.com/leaflabs/uioctl/raw/uioctl.c
```
